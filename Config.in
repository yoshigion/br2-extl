## Config.in
```kconfig
source "$BR2_EXTERNAL_YGION_PATH/package/libva-v4l2-request/Config.in"
source "$BR2_EXTERNAL_YGION_PATH/package/libva-dump/Config.in"
source "$BR2_EXTERNAL_YGION_PATH/package/v4l2-request-test/Config.in"
source "$BR2_EXTERNAL_YGION_PATH/package/uvc-gadget-upst/Config.in"
source "$BR2_EXTERNAL_YGION_PATH/package/uvc-gadget-ysgn/Config.in"
source "$BR2_EXTERNAL_YGION_PATH/package/uvc-gadget-clbh/Config.in"
source "$BR2_EXTERNAL_YGION_PATH/package/uvc-gadget-lnru/Config.in"
source "$BR2_EXTERNAL_YGION_PATH/package/uvc-gadget-lnrh/Config.in"
source "$BR2_EXTERNAL_YGION_PATH/package/uniphier_vpe/Config.in"
source "$BR2_EXTERNAL_YGION_PATH/package/test_mod/Config.in"
```

## package/Config.in
```kconfig
	source "package/libsvg-cairo/Config.in"
 	source "package/libsvgtiny/Config.in"
	source "package/libva/Config.in"
	source "package/libva-intel-driver/Config.in"
	source "package/libvdpau/Config.in"
	source "package/libvips/Config.in"
```

## package/libva-dump/Config.in
```kconfig
config BR2_PACKAGE_LIBVA_DUMP
	bool "libva-dump"
	select BR2_PACKAGE_LIBVA
	select BR2_PACKAGE_LIBDRM
	help
	  libva-dump allows dumping metadata and slices from videos.

	  https://github.com/bootlin/libva-dump

comment "libva-dump needs a toolchain w/ threads, dynamic library"
	depends on !BR2_TOOLCHAIN_HAS_THREADS || BR2_STATIC_LIBS
```

## package/libva-v4l2-request/Config.in
```kconfig
config BR2_PACKAGE_LIBVA_V4L2_REQUEST
	bool "libva-v4l2-request"
	select BR2_PACKAGE_LINUX_HEADERS
	select BR2_PACKAGE_LIBVA
	select BR2_PACKAGE_LIBDRM
	help
	  This libVA backend is designed to work with the Linux
	  Video4Linux2 Request API that is used by a number of
	  video codecs drivers, including the Video Engine found
	  in most Allwinner SoCs.

	  https://github.com/bootlin/libva-v4l2-request

comment "libva-v4l2-request needs a toolchain w/ threads, dynamic library"
	depends on !BR2_TOOLCHAIN_HAS_THREADS || BR2_STATIC_LIBS
```

## package/uvc-gadget-clbh/Config.in
```kconfig
menuconfig BR2_PACKAGE_UVC_GADGET_CLBH
	bool "uvc-gadget-clbh"
	help
	  uvc-gadget application of climberhunt

	  https://github.com/climberhunt/uvc-gadget.git
```

## package/uvc-gadget-lnrh/Config.in
```kconfig
menuconfig BR2_PACKAGE_UVC_GADGET_LNRH
	bool "uvc-gadget-lnrh"
	help
	  uvc-gadget application for YUVV uncompress payload
```

## package/uvc-gadget-lnru/Config.in
```kconfig
menuconfig BR2_PACKAGE_UVC_GADGET_LNRU
	bool "uvc-gadget-lnru"
	help
	  uvc-gadget application for YUVV uncompress payload
```

## package/uvc-gadget-upst/Config.in
```kconfig
menuconfig BR2_PACKAGE_UVC_GADGET_UPST
	bool "uvc-gadget-upst"
	help
	  uvc-gadget application upstream

	  git://git.ideasonboard.org/uvc-gadget.git
```

## package/uvc-gadget-ysgn/Config.in
```kconfig
menuconfig BR2_PACKAGE_UVC_GADGET_YSGN
	bool "uvc-gadget-ysgn"
	help
	  uvc-gadget application

	  https://github.com/yoshigion/uvc-gadget
```

## package/v4l2-request-test/Config.in
```kconfig
config BR2_PACKAGE_V4L2_REQUEST_TEST
	bool "v4l2-request-test"
	select BR2_PACKAGE_LIBVA
	select BR2_PACKAGE_LIBDRM
	select BR2_PACKAGE_LIBVA_V4L2_REQUEST
	help
	  This standalone tool was designed to help with development
	  and testing of the Cedrus driver, that supports the Video Engine
	  found on most Allwinner SoCs.
	  It implements the Linux v4l2 Request API, so it can help to test
	  any driver being developed using that API.

	  https://github.com/bootlin/v4l2-request-test

comment "v4l2-request-test needs a xserver_xorg-server"
	depends on !BR2_PACKAGE_XSERVER_XORG_SERVER
```
